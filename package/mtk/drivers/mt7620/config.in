## package/mtk/drivers/mt7620/config.in
```kconfig
choice
    prompt "MT7620 build type"
    depends on PACKAGE_kmod-mt7620 || PACKAGE_kmod-mt7620
    default MT7620_BUILD_KO
config  MT7620_BUILD_KO
    bool "build as module (MT7620.ko)"
    select PACKAGE_kmod-mt7620-ko
config  MT7620_BUILD_IN
    bool "build into kernel"
    select PACKAGE_kmod-mt7620-in
endchoice


# entries start with "KCONFIG" will be applied to kernel.
config  KCONFIG_WIFI_MT7620
    bool
    default y

# ---------------- 1st card ----------------
config  KCONFIG_FIRST_IF_MT7620
    bool
    select KCONFIG_WIFI_MT7620
    default y
config  KCONFIG_RT_FIRST_CARD
    string
    depends on KCONFIG_FIRST_IF_MT7620
    default "7620"
config  KCONFIG_RT_FIRST_IF_RF_OFFSET
    hex
    depends on KCONFIG_FIRST_IF_MT7620
    default 0x0
```

## package/mtk/drivers/mt7628/config.in
```kconfig
choice
    prompt "mt7628 build type"
    depends on PACKAGE_kmod-mt7628 || PACKAGE_kmod-mt7628
    default MT7628_BUILD_KO
config  MT7628_BUILD_KO
    bool "build as module (mt7628.ko)"
    select PACKAGE_kmod-mt7628-ko
config  MT7628_BUILD_IN
    bool "build into kernel"
    select PACKAGE_kmod-mt7628-in
endchoice


# entries start with "KCONFIG" will be applied to kernel.
config  KCONFIG_WIFI_MT7628
    bool
    default y

# ---------------- 1st card ----------------
config  KCONFIG_FIRST_IF_MT7628
    bool
    select KCONFIG_WIFI_MT7628
    default y
config  KCONFIG_RT_FIRST_CARD
    string
    depends on KCONFIG_FIRST_IF_MT7628
    default "7628"
config  KCONFIG_RT_FIRST_IF_RF_OFFSET
    hex
    depends on KCONFIG_FIRST_IF_MT7628
    default 0x0
```

## package/xplatform/huayi_cgi/Config.in
```kconfig
config HUAYI_CGI_INSTALL_PATH
	string "huayi cgi binary install path"
	depends on PACKAGE_huayi_cgi
	default "/etc/nginx/cgi-bin/"
	help
	  configure a path for huayi cgi install
	  
config HUAYI_CGI_COOKIE_SUPPORT
	bool	"Huayi Cookie Support"
	depends on PACKAGE_huayi_cgi
	default y

config HUAYI_CGI_WIZARD_SUPPORT
	bool	"Huayi Quick Setting Support"
	depends on PACKAGE_huayi_cgi
	default n
	
```

## package/xplatform/huayi_product/Config.in
```kconfig
choice
	prompt "Choose Web Type"
	depends on PACKAGE_huayi_product
	help
	  Choose different web types, the download paths are different 
	config NETBAK_ROUTER_WEB
		bool "netbak_router_web"
	config NEWUI_MTK3.6
		bool "newui_mtk3.6"
	config HUAYI_WEB_MTK3.6
		bool "huayi_web_mtk3.6"
    endchoice
	
choice
	prompt "Web Code Type"
	depends on PACKAGE_huayi_product
	help
	  Definition of Web Code Compile for development and release
	config HUAYI_WEB_RELEASE
		bool "Product Release"
	config HUAYI_WEB_DEVELOPMENT
		bool "Product Development"
	config HUAYI_WEB_LOCAL_FILE
		bool "Product Use Local Files"
    endchoice
```
